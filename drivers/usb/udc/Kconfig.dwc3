## drivers/usb/udc/Kconfig.dwc3
```kconfig
# SPDX-FileCopyrightText: Copyright tinyVision.ai Inc.
# SPDX-License-Identifier: Apache-2.0

config UDC_DWC3
	bool "Synopsys USB device controller driver"
	default y
	select NOCACHE_MEMORY if ARCH_HAS_NOCACHE_MEMORY_SUPPORT
	select UDC_BUF_FORCE_NOCACHE
	select UDC_DRIVER_HAS_HIGH_SPEED_SUPPORT
	select UDC_DRIVER_HAS_SUPER_SPEED_SUPPORT
	depends on DT_HAS_SNPS_DWC3_ENABLED
	help
	  Synopsys DWC3 USB device controller driver.

if UDC_DWC3

config UDC_DWC3_EVENTS_NUM
	int "Number of events in the event ring buffer"
	default 16
	help
	  It is typically not needed to increase the number of events, but
	  if it were to happen due to some rare condition, increasing this
	  number could be useful.

config UDC_DWC3_TRB_NUM
	int "Number of buffers for each non-control endpoint"
	default 4
	range 3 32
	help
	  This is a general knob for the number of buffers present for each
	  endpoint. This does not affect control endpoints. The default is
	  enough for most conditions, but for performance and debug purposes,
	  increasing could reveal useful.

config UDC_DWC3_SHELL
	bool "Debug shell for inspecting DWC3 internals"
	depends on SHELL
	help
	  Enable debug shell commands for debugging DWC3 and USB low-level access, such as
	  inspecting the list of ongoing transactions.

endif # UDC_DWC3

config UDC_DWC3_COMPLETION_POLL
	bool "Recover bulk transfer completions the controller never reported"
	help
	  This Soft-IP sometimes clears HWO on a CPU-managed bulk TRB without
	  posting a DEPEVT, under concurrent UVC + CDC load. The event thread
	  then never retires the buffer: on OUT the received packet is never
	  handed to the class and the host's write stalls forever, on IN the
	  class stops enqueueing. Neither direction recovers on its own, and a
	  host-side timeout on the stalled endpoint kills an URB, whose xHCI
	  Stop Endpoint this device cannot retire -- which takes the whole host
	  controller down.

	  When enabled, a periodic tick on the UDC work queue retires bulk
	  slots whose HWO has stayed clear for a grace interval, synthesising
	  the XferInProgress that was dropped. Endpoints owned by the video
	  RTL are skipped: the RTL retires those itself.

config UDC_DWC3_COMPLETION_POLL_MS
	int "Completion poll interval (ms)"
	default 100
	depends on UDC_DWC3_COMPLETION_POLL
	help
	  Keep this well below the host's bulk timeout so a dropped completion
	  is recovered before the host gives up on the endpoint.

config UDC_DWC3_COMPLETION_POLL_TICKS
	int "Grace ticks before retiring a completion in software"
	default 8
	depends on UDC_DWC3_COMPLETION_POLL
	help
	  Ticks that HWO must stay clear before a software retire. Too short
	  races a live DEPEVT and desyncs the ring; the reference tree found
	  2 ticks (~200 ms) raced real events and settled on 8 (~800 ms).

config UDC_DWC3_PARK_NUDGE
	bool "Re-ring the doorbell on a bulk endpoint whose TRB is never fetched"
	depends on UDC_DWC3_COMPLETION_POLL
	help
	  The completion poll recovers a transfer the controller finished but
	  never reported. This recovers the other half of the same defect: a
	  transfer the controller never started, because the UpdateXfer
	  doorbell was dropped under UVC load. The tail TRB stays owned by
	  hardware with its remaining count frozen, which no completion poll
	  can see, and the endpoint is stuck until the host gives up.

	  Measured on 2026-11-09: CDC-ACM ran normally for ~240 writes with
	  both video lanes streaming, then the completion poll rescued 8 round
	  trips, and then HWO stopped clearing at all -- a started-but-never-
	  fetched transfer, not a dropped completion.

	  Recovery here is only to re-issue UpdateXfer, capped and with a
	  cooldown. It deliberately does NOT tear down and rebuild the ring
	  (the reference tree's escalation path), because an armed TRB with a
	  frozen remaining count is also the normal state of an endpoint the
	  host has simply not polled yet, and re-ringing a doorbell is
	  harmless there while rebuilding a live ring is not.

config UDC_DWC3_PARK_NUDGE_MS
	int "Time a bulk TRB may stay unfetched before a nudge (ms)"
	default 2000
	depends on UDC_DWC3_PARK_NUDGE
	help
	  Must be long enough that an idle host poll does not look like a
	  park, and well inside the host's bulk timeout.

config UDC_DWC3_PARK_NUDGE_CAP
	int "Consecutive nudges before giving up on an endpoint"
	default 6
	depends on UDC_DWC3_PARK_NUDGE

config UDC_DWC3_HW_IN_EP_MASK
	hex "IN endpoints whose TRBs the video RTL owns"
	default 0x0
	help
	  Bitmask of IN endpoint indexes driven by the UsbMgr RTL rather than
	  the CPU (bit 3 = 0x83, bit 4 = 0x84; 0x18 for dual bulk UVC).

	  These endpoints get no XferComplete/XferInProgress events. The RTL
	  retires its own TRBs, so every such event is one the CPU does not
	  need -- and at two lanes of 1640x1232 it is tens of thousands per
	  second into an event ring sized in the tens of slots. The ring then
	  starves of the ACM completions that do matter, which is the defect
	  the completion poll was papering over.

config UDC_DWC3_IN_RECOVER_EP_MASK
	hex "IN endpoints eligible for software recovery"
	default 0x0
	depends on UDC_DWC3_COMPLETION_POLL
	help
	  Bitmask of IN endpoint indexes the completion poll and park nudge
	  may touch (bit 2 = 0x82). Recovery must never be aimed at an
	  RTL-owned endpoint, and a mask makes that a build-time property
	  rather than a runtime check that could be reached mid-handoff.

config UDC_DWC3_ARM_PACKET_HOLD
	bool "Arm the arbiter packet hold (MBX_TRB) on recoverable IN endpoints"
	depends on UDC_DWC3_COMPLETION_POLL
	help
	  Writes MBX_TRB before a StartXfer/UpdateXfer on the endpoints
	  IN_RECOVER_EP_MASK names, which arms the arbiter's packet hold: it
	  keeps the next video doorbell off the pipe while a bulk IN short
	  packet is still in its TX FIFO. Without the hold, a video UpdateXfer
	  can run first, DWC3 drops the transfer, and the TRB stays HWO with
	  its remaining count at the full length.

	  Off by default, because on this design it is a measured cost with no
	  measured benefit (2026-11-09): arming it took both 1640x1232 lanes
	  from 27.00 to 24.01 fps -- about 11% of frames -- and the CDC-ACM
	  endpoint still wedged at the same point. Adding the flat hold on top
	  (QUIET_OTHER=60000) cost 22% and still wedged.

	  The hold is bounded, not a hang risk: fifoStuckTo releases it after
	  1,500,000 cycles plus the 7,500-cycle probe delay, and HOLD_MAX_US
	  was measured at 1,507,508 -- that backstop firing, to within the
	  8-cycle bus read latency. But a 20 ms video stall per occurrence is
	  half a frame interval at 27 fps.

	  Enable it only where the transfer-drop mechanism is known to be the
	  failure, which on the reference single-UVC SRP configuration it is.

config UDC_DWC3_OUT_NOTREADY_RETAKE
	bool "Nudge a bulk OUT whose doorbell was dropped (UpdateXfer only)"
	help
	  Enables XferNotReady on bulk OUT endpoints and issues UpdateXfer
	  when one arrives while the tail TRB is already armed with HWO set.
	  That combination means the doorbell was dropped: the TRB looks armed
	  but no transfer was ever started, so the device NAKs the host
	  forever while the host's write URB sits pending.

	  UpdateXfer only, with a 200 ms per-endpoint cooldown.  Deliberately
	  NOT EndXfer+StartXfer, which is what an earlier version of this help
	  text described and what this tree briefly implemented.  new_arch
	  abandoned that: the function is still present there as
	  udc_dwc3_out_notready_recycle() and is called from nowhere, with the
	  reasons recorded beside it -- "EndXfer spam under UVC wedges EP0
	  (Malformed setup)" and "EndXfer(ForceRM) under Soft-IP UVC has
	  wedged EP0".  Both peer sessions confirmed the dead-code status
	  independently on 2026-11-10.

	  Distinguish this from an idle OUT, which legitimately sits at HWO=1
	  waiting for the host and must NOT be disturbed -- treating that as
	  stuck causes false recoveries and can break ACM enumeration.  An
	  UpdateXfer is harmless in that case, which is the point of
	  preferring it.

	  Default n, matching all three new_arch applications
	  (fresh/app/prj.conf:59, fresh/app_flir/prj.conf:74,
	  priv-flir/zephyr/app/prj.conf:81).  Neither peer tree has any soak
	  evidence for this path; it is kept available, not recommended.

config UDC_DWC3_OUT_STALL_REFRESH
	bool "Refresh a stalled bulk OUT on a timer (UpdateXfer only)"
	depends on UDC_DWC3_OUT_NOTREADY_RETAKE
	help
	  Soft-IP often never posts XferNotReady for a wedged ACM OUT, so an
	  event handler alone cannot see the stall: measured here on
	  2026-11-10, exactly ONE XferNotReady arrived across a 300 s soak
	  that wedged.  Every UDC_DWC3_OUT_STALL_REFRESH_MS, UpdateXfer any
	  armed bulk OUT tail.  UpdateXfer is a no-op on a healthy idle OUT
	  and carries none of the EP0 risk that EndXfer spam did.

	  Ported from new_arch udc_dwc3.c:6646-6681.  Default n: new_arch
	  ships it off with the note "even at 1s it correlates with earlier
	  ACM cliffs" (fresh/app/prj.conf:73), so it is available here for
	  measurement rather than recommended.

config UDC_DWC3_OUT_STALL_REFRESH_MS
	int "OUT stall observation window (ms)"
	default 250
	depends on UDC_DWC3_OUT_STALL_REFRESH
```

## dts/bindings/serial/zephyr,cdc-raw.yaml
```yaml
# Copyright tinyVision.ai

description: USB CDC ACM with lower level API

compatible: "zephyr,cdc-raw"

on-bus: usb
```

## subsys/usb/device_next/class/Kconfig.cdc_acm
```kconfig
# Copyright (c) 2022 Nordic Semiconductor ASA
#
# SPDX-License-Identifier: Apache-2.0

config USBD_CDC_ACM_CLASS
	bool "USB CDC ACM implementation"
	depends on SERIAL
	depends on DT_HAS_ZEPHYR_CDC_ACM_UART_ENABLED
	select SERIAL_HAS_DRIVER
	select SERIAL_SUPPORT_INTERRUPT
	select RING_BUFFER
	select UART_INTERRUPT_DRIVEN
	default y
	help
	  USB device CDC ACM class implementation.

if USBD_CDC_ACM_CLASS

config USBD_CDC_ACM_RX_OUTSTANDING
	int "Number of OUT transfers kept armed on the bulk OUT endpoint"
	default 2
	range 1 8
	help
	  How many host-to-device transfers the class keeps armed at once.

	  With 1 the ring goes empty every time a transfer retires. Controllers
	  that park an endpoint on such a "run dry" event then need an explicit
	  resume, which is unreliable on some DWC3 hard IP (the DepUpdateXfer is
	  silently dropped and the endpoint wedges, so host-to-device data stops
	  flowing). Keeping 2 or more armed avoids the park condition entirely.

	  Each armed transfer consumes one buffer of the endpoint pool and needs
	  a matching amount of free space in the RX FIFO, so raising this also
	  wants a larger UART RX ring buffer.

config USBD_CDC_ACM_WORKQUEUE
	bool "Use dedicated workqueue in CDC ACM"
	help
	  Use the dedicated queue in CDC ACM implementation if the systemwork
	  queue cannot be used due to performance issues or other conflicts.

config USBD_CDC_ACM_STACK_SIZE
	int "USB CDC ACM workqueue stack size"
	depends on USBD_CDC_ACM_WORKQUEUE
	default 1024
	help
	  USB CDC ACM workqueue stack size.

config USBD_CDC_ACM_WORKQUEUE_PRIORITY
	int "USB CDC ACM workqueue thread priority"
	depends on USBD_CDC_ACM_WORKQUEUE
	default SYSTEM_WORKQUEUE_PRIORITY
	help
	  Thread priority of the dedicated CDC ACM workqueue.  Defaults to the
	  system workqueue priority for backwards compatibility.

	  The CDC ACM handlers re-submit their own work to keep the bulk IN
	  pipe full, so the workqueue can stay continuously runnable under load.
	  If it runs at a cooperative priority equal to the UDC driver's
	  workqueue, it can never yield to it, starving the endpoint worker that
	  arms and retires the IN transfers it depends on — a livelock (the CDC
	  IN pipe wedges and the CPU is pegged in cdc_acm_work_q).  Set a
	  preemptible priority (>= 0) so the cooperative UDC workqueue can
	  preempt it and make forward progress.

config USBD_CDC_ACM_BUF_POOL
	bool "Use dedicated buffer pool"
	default y if !USBD_MAX_SPEED_FULL
	help
	  Use a dedicated buffer pool whose size is based on the number of CDC
	  ACM instances and the size of the bulk endpoints. When disabled, the
	  implementation uses the UDC driver's pool.

module = USBD_CDC_ACM
module-str = usbd cdc_acm
default-count = 1
source "subsys/logging/Kconfig.template.log_config"

endif
```
