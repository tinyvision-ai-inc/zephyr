## dts/bindings/usb/uvc/zephyr,uvc-control-selector.yaml
```yaml
# Copyright (c) 2024 tinyVision.ai Inc.
# SPDX-License-Identifier: Apache-2.0

description: UVC Selector Unit controls for choosing one of several sources

compatible: "zephyr,uvc-control-selector.yaml"

include: "zephyr,uvc-control.yaml"

properties:

  source-entity:
    type: phandle-array
    requited: true
    description: |
      Entities connected as input to the Selector Unit.
      The target video device will receive the host's source switch requests.
```

## dts/bindings/usb/uvc/zephyr,uvc-control-xu.yaml
```yaml
# Copyright (c) 2024 tinyVision.ai Inc.
# SPDX-License-Identifier: Apache-2.0

description: UVC Extension Unit for custom vendor-specific controls

compatible: "zephyr,uvc-control-xu"

include: "zephyr,uvc-control.yaml"

properties:

  control-num:
    type: int
    required: true
    description: |
      Number of controls enabled, with control codes 0x00, 0x01, 0x02, 0x03...

  guid:
    type: uint8-array
    required: true
    description: |
      GUID that identifies the control block
```

## dts/bindings/usb/uvc/zephyr,uvc-control.yaml
```yaml
# Copyright (c) 2024 tinyVision.ai Inc.
# SPDX-License-Identifier: Apache-2.0

# USB Video Class control common properties.

include: base.yaml

properties:

  control-target:
    type: phandle
    description: |
      Reference to a video device which this control should affect.

  control-ids:
    type: array
    description: |
      List of control IDs which marked as supported by the USB device.
      UVC controls are mapped to entries of video-controls.h when passed to
      the control target.
```

## dts/bindings/usb/uvc/zephyr,uvc-format-uncompressed.yaml
```yaml
# Copyright (c) 2024 tinyVision.ai Inc.
# SPDX-License-Identifier: Apache-2.0

description: |
  USB Video Class list of supported uncompressed frame formats.

compatible: "zephyr,uvc-format-uncompressed"

include: zephyr,uvc-format.yaml

properties:
  guid:
    type: uint8-array
    description: |
      GUID that identifies the frame format. A list of GUIDs suported by the
      Linux kernel can be found on the include/linux/usb/uvc.h file.
    required: true

  bits-per-pixel:
    type: int
    description: |
      Number of bit for one pixel. This must match the pixel format specified
      by the GUID.
    required: true
```

## dts/bindings/usb/uvc/zephyr,uvc-format.yaml
```yaml
# Copyright (c) 2024 tinyVision.ai Inc.
# SPDX-License-Identifier: Apache-2.0

# USB Video Class format common properties.

child-binding:
  description: |
    Enumeration of all frame dimensions supported for this format.

  properties:

    size:
      type: array
      description: |
        Frame width and size in pixel, from which can be deduced the
        frame size since this is an uncompressed format.
      required: true

    fps:
      type: int
      description: |
        Maximum FPS supported end-to-end for this frame format.
        No min FPS: assumes that frames can be delayed indefinitely.
      required: true
```

## dts/bindings/usb/uvc/zephyr,uvc-input-terminal.yaml
```yaml
# Copyright (c) 2024 tinyVision.ai Inc.
# SPDX-License-Identifier: Apache-2.0

description: USB Video Class Input Terminal entity
  Port element as described by the video driver API.
  An UVC input terminal node only contains a single port, and a single
  endpoint per port. If multiple endpoints are required, multiple Input
  Terminals nodes should be declared instead.

compatible: "zephyr,uvc-input-terminal"

include: video-device.yaml
```

## dts/bindings/usb/uvc/zephyr,uvc.yaml
```yaml
# Copyright (c) 2024 tinyVision.ai Inc.
# SPDX-License-Identifier: Apache-2.0

description: USB Video Class instance

compatible: "zephyr,uvc"

properties:
  source: 
    type: phandle
    description: |
      A reference to an associated video-device. This device will get started,
      stopped or configured following the requests from the host.
    required: false

# Child nodes of "zephyr,uvc" compatibles are supposed to be:
# - Video Control entity named "port", which also matches the port, endpoint,
#   remote-endpoint syntax of devicetrees.
# - Video Streaming entity, which list the formats available.

on-bus: usb
```

## dts/bindings/usb/zephyr,uvc-device.yaml
```yaml
# Copyright (c) 2024 tinyVision.ai Inc.
# SPDX-License-Identifier: Apache-2.0

description: |
  USB Video Class instance

  The Video Class will scan the devicetree nodes seeking for video
  devices recognized by the "video-controls" node. Each video device
  will be represented on the USB by its own descriptor, which will allow
  the host to tune it according to the entries of "video-controls".

  Depending on the number of input and output, the appropriate USB
  control block is assigned, which only leaves the format definition
  to configure.

  Any number of endpoint can be instantiated, leading to several UVC
  stream within a same instance.

  Example:

    uvc: uvc {
      compatible = "zephyr,uvc-device";
      port {
        endpoint {
          remote-endpoint-label = "mipi0_in";
          direction = "in";
          formats = <&uvc VIDEO_PIX_FMT_YUYV 16 1920 1080 30>,
                    <&uvc VIDEO_PIX_FMT_YUYV 16 1280 720 60>;
        };
      };
    };

compatible: "zephyr,uvc-device"

include: video-device.yaml

on-bus: usb

properties:
  video-controls:
    default: []

  "#format-cells":
    type: int
    const: 5

child-binding:
  child-binding:
    properties:

      formats:
        type: phandle-array
        required: true
        description: |
          List of frame formats exposed to the host for this endpoint.
          Zephyr video drivers support format range (min, max) but UVC supports
          only discrete values.

format-cells:
  - fourcc
  - bits-per-pixel
  - width
  - height
  - max-fps
```

## dts/bindings/video/sony,imx219.yaml
```yaml
# Copyright (c) 2024, tinyVision.ai Inc.
# SPDX-License-Identifier: Apache-2.0

description: IMX219 CMOS video sensor

compatible: "sony,imx219"

include: [i2c-device.yaml, video-device.yaml]
```

## dts/bindings/video/tinyvision,pixelpump.yaml
```yaml
# Copyright (c) 2024 tinyVision.ai Inc.
# SPDX-License-Identifier: Apache-2.0

description: MIPI-CSI controller core for FPGA architectures

compatible: "tinyvision,pixelpump"

# TODO generates an _ORD set to -1 when this is included on both side
#include: video-device.yaml
```

## dts/bindings/video/tinyvision,tinygen.yaml
```yaml
# Copyright (c) 2024, tinyVision.ai Inc.
# SPDX-License-Identifier: Apache-2.0

description: small pattern generator

compatible: "tinyvision,tinygen"

#include: video-device.yaml
```

## dts/bindings/video/tinyvision,uvcmanager.yaml
```yaml
# Copyright (c) 2024 tinyVision.ai Inc.
# SPDX-License-Identifier: Apache-2.0

description: |
    USB Video Class Manager to transfer a MIPI feed to an UVC video endpoint

compatible: "tinyvision,uvcmanager"

include: base.yaml

properties:
  reg:
    required: true

  source:
    type: phandle
    description: |
      Source device that is to provide data to the UVC Manager.
      In order to perform debayer, it needs to support 2 more rows and columns
      of pixels than what the UVC Manager is confirued for, usually from the
      USB host over UVC probe/commit commands.
    required: false
```

## dts/bindings/video/video-device.yaml
```yaml
# Copyright (c) 2024 tinyVision.ai Inc.
# SPDX-License-Identifier: Apache-2.0

# Common fields for video devices

include: base.yaml

properties:

  video-controls:
    type: string-array
    description: |
      Array of Control IDs (CIDs) that the video device supports. Each
      element is a string matching a CID entry as listed in the header file
      <zephyr/drivers/video-controls.h>. This list of CIDs permit protocol to
      generate list of control capabilities supported by each hardware at
      build-time.

child-binding:
  child-binding:
    include: video-interfaces.yaml
```

## dts/bindings/video/zephyr,emul-imager.yaml
```yaml
# Copyright 2024 tinyVision.ai Inc.
# SPDX-License-Identifier: Apache-2.0

description: Emulated Imager for testing purpose

compatible: "zephyr,emul-imager"

include: video-device.yaml

properties:

  video-controls:
    default: ["CID_CAMERA_EXPOSURE", "CID_CAMERA_GAIN"]
```

## dts/bindings/video/zephyr,emul-mipi-rx.yaml
```yaml
# Copyright 2024 tinyVision.ai Inc.
# SPDX-License-Identifier: Apache-2.0

description: Emulated Video DMA engine for testing purpose

compatible: "zephyr,emul-mipi-rx"

include: video-device.yaml

properties:

  video-controls:
    default: ["VIDEO_CID_CAMERA_HUE"]
```

## dts/bindings/video/zephyr,uvc.yaml
```yaml
# Copyright (c) 2021 Nordic Semiconductor ASA
# SPDX-License-Identifier: Apache-2.0

description: USB UVC

compatible: "zephyr,uvc"

on-bus: usb

properties:
  payload-addr:
    type: int
    description: |
      Address of a video memory buffer.

  payload-size:
    type: int
    description: |
      Size of the video memory buffer.
```

## dts/bindings/video/zephyr,video-emul-rx.yaml
```yaml
# Copyright 2024 tinyVision.ai Inc.
# SPDX-License-Identifier: Apache-2.0

description: |
  Emulated Video DMA engine for testing purpose
  Endpoint 0 is expected to be connected to a zephyr,video-emul-imager device.
  Endpoint 1 is optional and is the output to any sink.

compatible: "zephyr,video-emul-rx"

child-binding:
  child-binding:
    include: video-interfaces.yaml
```

## soc/tinyvision/tinyclunx33/Kconfig.defconfig
```kconfig
# Copyright (c) 2024, tinyVision.ai Inc.
# SPDX-License-Identifier: Apache-2.0

if SOC_TINYCLUNX33

config SYS_CLOCK_HW_CYCLES_PER_SEC
	default $(dt_node_int_prop_int,/cpus/cpu@0,clock-frequency)

config NUM_IRQS
	default 12

config MINIMAL_LIBC
	default y

endif # SOC_TINYCLUNX33
```

## soc/tinyvision/tinyclunx33/Kconfig.soc
```kconfig
# Copyright (c) 2024, tinyVision.ai Inc.
# SPDX-License-Identifier: Apache-2.0

config SOC_SERIES_TINYCLUNX33
	bool
	help
	  tinyCLUNX33 FPGA-based SoC series.
	  Each SoC under this series is a release of an FPGA RTL ("gateware")
	  that implements the virtual SoC loaded onto the FPGA. They are
	  published by tinyVision.ai.

config SOC_TINYCLUNX33V008
	bool
	help
	  The tinyCLUNX33 RTLv0.8 release. This SoC lacks MIPI support, but
	  features a test pattern generator that permits to test the USB
	  bandwidth.
	select SOC_SERIES_TINYCLUNX33

config SOC_TINYCLUNX33V009
	bool
	help
	  The tinyCLUNX33 RTLv0.9 release. This SoC introduces MIPI support.
	select SOC_SERIES_TINYCLUNX33

config SOC_TINYCLUNX33V010
	bool
	help
	  The tinyCLUNX33 RTLv0.10 release.
	select SOC_SERIES_TINYCLUNX33

config SOC_SERIES
	default "tinyclunx33" if SOC_SERIES_TINYCLUNX33

config SOC
	default "tinyclunx33v008" if SOC_TINYCLUNX33V008
	default "tinyclunx33v009" if SOC_TINYCLUNX33V009
	default "tinyclunx33v010" if SOC_TINYCLUNX33V010
```

## subsys/usb/device_next/class/Kconfig.cdc_uvc
```kconfig
# Copyright (c) 2022 Nordic Semiconductor ASA
#
# SPDX-License-Identifier: Apache-2.0

config USBD_CDC_UVC_CLASS
	bool "USB CDC UVC implementation [EXPERIMENTAL]"
	help
	  USB device CDC UVC class implementation.

if USBD_CDC_UVC_CLASS

config USBD_CDC_UVC_STACK_SIZE
	int "USB CDC UVC workqueue stack size"
	default 1024
	help
	  USB CDC UVC workqueue stack size.

module = USBD_CDC_UVC
module-str = usbd cdc_uvc
default-count = 1
source "subsys/logging/Kconfig.template.log_config"

endif
```

## subsys/usb/device_next/class/Kconfig.uvc
```kconfig
# Copyright (c) 2024 tinyVision.ai
#
# SPDX-License-Identifier: Apache-2.0

config USBD_VIDEO_CLASS
	bool "USB Video Class implementation [EXPERIMENTAL]"
	depends on DT_HAS_ZEPHYR_UVC_DEVICE_ENABLED
	help
	  USB Device Video Class (UVC) implementation.

if USBD_VIDEO_CLASS

config USBD_VIDEO_HEADER_SIZE
	int "USB Video payload header size"
	range 12 64
	default 12
	help
	  Sets the size of the video payload header,
	  to allow custom data to be added at the end of the mandatory fields.

config USBD_VIDEO_MAX_STREAMS
	int "Max number of video output stream per USB Video interface"
	range 1 254
	default 8
	help
	  Each video stream is mapped to a video endpoint on the devicetree.
	  This limits the number of endpoints that can be declared for each
	  UVC instance.

config USBD_VIDEO_MAX_FRMIVAL
	int "Max number of video output stream per USB Video interface"
	range 1 255
	default 8
	help
	  Max number of Frame Interval listed on a frame descriptor.

config USBD_VIDEO_MAX_VS_DESC
	int "Max number of descriptors generated per VideoStreaming interface"
	default 8
	help
	  Sets the maximum number of Format and Frame descriptors that can be
	  generated at runtime per VideoStreaming interface; an array size.
	  This may only need to be increased if you encounter a warning
	  at init time saying there are not enough descriptors available.

module = USBD_UVC
module-str = usbd uvc
default-count = 1
source "subsys/logging/Kconfig.template.log_config"

endif
```
