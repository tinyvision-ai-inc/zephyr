## subsys/usb/device_next/class/Kconfig.cdc_ecm
```kconfig
# Copyright (c) 2023 Nordic Semiconductor ASA
#
# SPDX-License-Identifier: Apache-2.0

config USBD_CDC_ECM_CLASS
	bool "USB CDC ECM implementation"
	default y
	depends on NET_L2_ETHERNET
	depends on DT_HAS_ZEPHYR_CDC_ECM_ETHERNET_ENABLED
	help
	  USB CDC Ethernet Control Model (ECM) implementation"

if USBD_CDC_ECM_CLASS

config USBD_CDC_ECM_EXTERNAL_TX
	bool "Hand transmit frames to usbd_cdc_ecm_external_tx()"
	help
	  For hardware that owns the bulk IN endpoint and builds some of the
	  Ethernet frames itself. The class does not enqueue on that endpoint;
	  it passes each frame of the network stack to
	  usbd_cdc_ecm_external_tx(), which the application provides.

module = USBD_CDC_ECM
module-str = usbd cdc_ecm
default-count = 1
source "subsys/logging/Kconfig.template.log_config"

endif
```
