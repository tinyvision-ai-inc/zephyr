## boards/tinyvision/tinyclunx33/Kconfig.defconfig
```kconfig
# Copyright (c) 2024 tinyVision.ai Inc.
# SPDX-License-Identifier: Apache-2.0

if BOARD_TINYCLUNX33_SOM || BOARD_TINYCLUNX33_DEVKIT

# Workaround for not being able to have commas in macro arguments
DT_CHOSEN_Z_CODE_PARTITION := zephyr,code-partition

config FLASH_LOAD_SIZE
	default $(dt_chosen_reg_size_hex,$(DT_CHOSEN_Z_CODE_PARTITION))

config FLASH_LOAD_OFFSET
	default $(dt_chosen_reg_addr_hex,$(DT_CHOSEN_Z_CODE_PARTITION))

config XIP
	default y

# Si5351 PLL over I2C is required to set the UART clock, initialize it early

config I2C
	default y

config I2C_INIT_PRIORITY
	default 0

config CLOCK_CONTROL
	default y

endif # BOARD_TINYCLUNX33_SOM || BOARD_TINYCLUNX33_DEVKIT

if BOARD_TINYCLUNX33_DEVKIT

config SERIAL
	default y

config CONSOLE
	default y

config UART_CONSOLE
	default y

config UART_LINE_CTRL
	default y

endif # BOARD_TINYCLUNX33_DEVKIT
```

## boards/tinyvision/tinyclunx33/Kconfig.tinyclunx33
```kconfig
# Copyright (c) 2024 tinyVision.ai Inc.
# SPDX-License-Identifier: Apache-2.0

config BOARD_TINYCLUNX33
	select SOC_LITEX_VEXRISCV
	select HAS_FLASH_LOAD_OFFSET
```

## boards/tinyvision/tinyclunx33/Kconfig.tinyclunx33_devkit
```kconfig
# Copyright (c) 2024 tinyVision.ai Inc.
# SPDX-License-Identifier: Apache-2.0

config BOARD_TINYCLUNX33_DEVKIT
	# RTL releases supported for the tinyCLUNX33 Devkit Rev1 (End-of-Life status)
	select SOC_TINYCLUNX33V008 if BOARD_TINYCLUNX33_DEVKIT_REV1_TINYCLUNX33V008
	select SOC_TINYCLUNX33V009 if BOARD_TINYCLUNX33_DEVKIT_REV1_TINYCLUNX33V009
	select SOC_TINYCLUNX33V010 if BOARD_TINYCLUNX33_DEVKIT_REV1_TINYCLUNX33V010

	# RTL releases supported for the tinyCLUNX33 Devkit Rev2 (Active status)
	select SOC_TINYCLUNX33V008 if BOARD_TINYCLUNX33_DEVKIT_REV2_TINYCLUNX33V008
	select SOC_TINYCLUNX33V009 if BOARD_TINYCLUNX33_DEVKIT_REV2_TINYCLUNX33V009
	select SOC_TINYCLUNX33V010 if BOARD_TINYCLUNX33_DEVKIT_REV2_TINYCLUNX33V010

	select HAS_FLASH_LOAD_OFFSET
```

## boards/tinyvision/tinyclunx33/Kconfig.tinyclunx33_som
```kconfig
# Copyright (c) 2024 tinyVision.ai Inc.
# SPDX-License-Identifier: Apache-2.0

config BOARD_TINYCLUNX33_SOM
	# RTL releases supported for the tinyCLUNX33 SoM Rev1 (End-of-Life status)
	select SOC_TINYCLUNX33V008 if BOARD_TINYCLUNX33_SOM_REV1_TINYCLUNX33V008
	select SOC_TINYCLUNX33V009 if BOARD_TINYCLUNX33_SOM_REV1_TINYCLUNX33V009
	select SOC_TINYCLUNX33V010 if BOARD_TINYCLUNX33_SOM_REV1_TINYCLUNX33V010

	# RTL releases supported for the tinyCLUNX33 SoM Rev2 (Active status)
	select SOC_TINYCLUNX33V008 if BOARD_TINYCLUNX33_SOM_REV2_TINYCLUNX33V008
	select SOC_TINYCLUNX33V009 if BOARD_TINYCLUNX33_SOM_REV2_TINYCLUNX33V009
	select SOC_TINYCLUNX33V010 if BOARD_TINYCLUNX33_SOM_REV2_TINYCLUNX33V010

	select HAS_FLASH_LOAD_OFFSET
```

## boards/tinyvision/tinyclunx33/board.yml
```yaml
board:
  name: tinyclunx33_som
  vendor: tinyvision
  revision:
    format: custom
    default: "rev2"
    revisions:
      - name: "rev1"
      - name: "rev2"
  socs:
  - name: tinyclunx33v008
  - name: tinyclunx33v009
  - name: tinyclunx33v010

board:
  name: tinyclunx33_devkit
  vendor: tinyvision
  revision:
    format: custom
    default: "rev2"
    revisions:
      - name: "rev1"
      - name: "rev2"
  socs:
  - name: tinyclunx33v008
  - name: tinyclunx33v009
  - name: tinyclunx33v010
```

## boards/tinyvision/tinyclunx33/tinyclunx33_defconfig
```kconfig
# Copyright (c) tinyVision.ai Inc.
# SPDX-License-Identifier: Apache-2.0

# Enable I2C as there are I2C peripherals on-board (Rev2)
CONFIG_I2C=y
CONFIG_I2C_LITEX=y

# As the I2C is required to get the clock used by the UART, initialize it earlier
CONFIG_I2C_INIT_PRIORITY=0

# Enable the Si5351 PLL on I2C bus
CONFIG_CLOCK_CONTROL=y
CONFIG_CLOCK_CONTROL_SI5351=y

# Enable the USB silicon core present on-chip
CONFIG_USB_DEVICE_STACK_NEXT=y

# Disable GPIO
CONFIG_GPIO=n

# Enable UART console for debug logs and shell
CONFIG_SERIAL=y
CONFIG_CONSOLE=y
CONFIG_UART_CONSOLE=y
CONFIG_UART_LITEUART=y
CONFIG_UART_LINE_CTRL=y

# Optimize the shell to much more TX buffer size
CONFIG_SHELL_BACKEND_SERIAL_TX_RING_BUFFER_SIZE=256

# Enable the system timer
CONFIG_LITEX_TIMER=y

# Enable the video pipeline
CONFIG_VIDEO=y
CONFIG_VIDEO_UVCMANAGER=y

# Enable execution in-place from flash
CONFIG_XIP=y

# Avoid a bug preventing the firmware to start
CONFIG_MINIMAL_LIBC=y

# Generated by LiteX litex_json2dts.py
CONFIG_ETH_LITEETH=n
CONFIG_SPI_LITESPI=n
CONFIG_I2S_LITEX=n
CONFIG_I2S_LITEX=n
CONFIG_CLOCK_CONTROL_LITEX=n
CONFIG_LITEX_CSR_DATA_WIDTH=32
```

## drivers/sensor/lsm6dsr/Kconfig
```kconfig
# ST Microelectronics LSM6DSR 6-axis IMU sensor driver

# Copyright (c) 2019 STMicroelectronics
# SPDX-License-Identifier: Apache-2.0

menuconfig LSM6DSR
	bool "LSM6DSR I2C/SPI accelerometer and gyroscope Chip"
	default y
	depends on DT_HAS_ST_LSM6DSR_ENABLED
	depends on ZEPHYR_HAL_ST_MODULE
	select I2C if $(dt_compat_on_bus,$(DT_COMPAT_ST_LSM6DSR),i2c)
	select SPI if $(dt_compat_on_bus,$(DT_COMPAT_ST_LSM6DSR),spi)
	select HAS_STMEMSC
	select USE_STDC_LSM6DSR
	help
	  Enable driver for LSM6DSR accelerometer and gyroscope
	  sensor.

if LSM6DSR

choice LSM6DSR_TRIGGER_MODE
	prompt "Trigger mode"
	help
	  Specify the type of triggering to be used by the driver.

config LSM6DSR_TRIGGER_NONE
	bool "No trigger"

config LSM6DSR_TRIGGER_GLOBAL_THREAD
	bool "Use global thread"
	depends on GPIO
	select LSM6DSR_TRIGGER

config LSM6DSR_TRIGGER_OWN_THREAD
	bool "Use own thread"
	depends on GPIO
	select LSM6DSR_TRIGGER

endchoice

config LSM6DSR_TRIGGER
	bool

if LSM6DSR_TRIGGER

config LSM6DSR_THREAD_PRIORITY
	int "Thread priority"
	depends on LSM6DSR_TRIGGER_OWN_THREAD
	default 10
	help
	  Priority of thread used by the driver to handle interrupts.

config LSM6DSR_THREAD_STACK_SIZE
	int "Thread stack size"
	depends on LSM6DSR_TRIGGER_OWN_THREAD
	default 1024
	help
	  Stack size of thread used by the driver to handle interrupts.

endif # LSM6DSR_TRIGGER

config LSM6DSR_ENABLE_TEMP
	bool "Temperature"
	help
	  Enable/disable temperature

config LSM6DSR_SENSORHUB
	bool "I2C sensorhub feature"
	help
	  Enable/disable internal sensorhub. You can enable
	  a maximum of two external sensors (if more than two are enabled
	  the system would enumerate only the first two found)

if LSM6DSR_SENSORHUB

config LSM6DSR_EXT_LIS2MDL
	bool "LIS2MDL as external sensor"
	default y

config LSM6DSR_EXT_LPS22HH
	bool "LPS22HH as external sensor"
	default y

config LSM6DSR_EXT_HTS221
	bool "HTS221 as external sensor"

config LSM6DSR_EXT_LPS22HB
	bool "LPS22HB as external sensor"

endif # LSM6DSR_SENSORHUB

endif # LSM6DSR
```

## drivers/usb/udc/Kconfig.usb23
```kconfig
# Copyright (c) 2023 tinyVision.ai
# SPDX-License-Identifier: Apache-2.0

config UDC_USB23
	bool "Lattice USB device controller driver"
	imply UDC_WORKQUEUE
	default y
	depends on DT_HAS_LATTICE_USB23_ENABLED
	help
	  Lattice USB23 USB device controller driver.

module = UDC_USB23
module-str = usb23 drv
source "subsys/logging/Kconfig.template.log_config"
```

## drivers/video/Kconfig.imx219
```kconfig
config VIDEO_IMX219
	bool "IMX219 8 Mega-Pixel CMOS image sensor"
	select I2C
	depends on DT_HAS_SONY_IMX219_ENABLED
	default y
	help
	  Enable driver for IMX219 8 Mega-Pixel CMOS image sensor
```

## drivers/video/Kconfig.pixelpump
```kconfig
# Copyright (c) 2024 tinyVision.ai Inc.
# SPDX-License-Identifier: Apache-2.0

config VIDEO_PIXELPUMP
	bool "PixelPump MIPI-CSI controller"
	depends on DT_HAS_TINYVISION_PIXELPUMP_ENABLED
	default y
	help
	  Enable driver for the PixelPump MIPI-CSI controller
```

## drivers/video/Kconfig.shell
```kconfig
# Copyright The Zephyr Project Contributors
# SPDX-License-Identifier: Apache-2.0

config VIDEO_SHELL
	bool "Video shell"
	depends on SHELL
	help
	  This shell provides control and query commands for video drivers.
```

## drivers/video/Kconfig.tinygen
```kconfig
# Copyright (c) 2024 tinyVision.ai Inc.
# SPDX-License-Identifier: Apache-2.0

config VIDEO_TINYGEN
	bool "tinyGEN ad-hoc pattern generator"
	select I2C
	depends on DT_HAS_TINYVISION_TINYGEN_ENABLED
	default y
	help
	  Enable driver for tinyGEN pattern generator
```

## drivers/video/Kconfig.uvcmanager
```kconfig
# Copyright (c) 2024 tinyVision.ai Inc.
# SPDX-License-Identifier: Apache-2.0

config VIDEO_UVCMANAGER
	bool "uvcmanager ad-hoc pattern generator"
	depends on DT_HAS_TINYVISION_USB23_MANAGER_ENABLED
	default y
	help
	  Enable driver for uvcmanager pattern generator
```

## dts/bindings/gpio/arducam,dvp-20pin-connector.yaml
```yaml
# Copyright 2025 tinyVision.ai Inc.
# SPDX-License-Identifier: Apache-2.0

description: |
  GPIO pins exposed on ArduCam 20-pin header camera connector,
  originally designed to connect Arducam modules to Arduino Giga R1,
  but further used by other vendors of camera and devkits.

  The connector layout is depicted below:

     1   3V3          2   GND
     3   SCL          4   SDA
     5   VS           6   HS
     7   PCLK         8   XCLK
     9   D7           10  D6
     11  D5           12  D4
     13  D3           14  D2
     15  D1           16  D0
     17  PEN          18  PDN
     19  PEN          20  PDN

  In many variants, the last row containing the pins 19 and 20 is
  not present, and the pins 17 and 18 are used for the same purpose
  instead.

  The following node labels can be used for use in shields:

  - dvp_20pin_interface: the video interface that receives the video
    feed and use with the zephyr,camera chosen node.

  - dvp_20pin_ep_in: video endpoint of the devkit receiving the video
    feed (see video-interfaces.yaml).

  - dvp_20pin_ep_out: video endpoint of the camera module to interconnect
    with this endpoint (see video-interfaces.yaml).

  - dvp_20pin_i2c: the I2C device of the devkit on which the camera
    module is instantiated.

  - dvp_20pin_gpio: the gpio nexus using the arducam,dvp-20pin-connector
    that defines the camera 'reset' pin, 'power-down' pin, etc.

  See <zephyr/dt-bindings/gpio/dvp-20pin-gpio.h> for pin description.

compatible: "arducam,dvp-20pin-connector"

include: [gpio-nexus.yaml, base.yaml]
```

## dts/bindings/i2c/nxp,pca9542a.yaml
```yaml
# Copyright (c) 2024 tinyVision.ai Inc.
# SPDX-License-Identifier: Apache-2.0

description: NXP PCA9542A 2-channel multiplexer

compatible: "nxp,pca9542a"

include: i2c-device.yaml

child-binding:
  compatible: "nxp,pca9542a-channel"
  include: i2c-controller.yaml
  on-bus: i2c
```

## dts/bindings/serial/zephyr,cdc-uvc.yaml
```yaml
# Copyright (c) 2021 Nordic Semiconductor ASA
# SPDX-License-Identifier: Apache-2.0

description: USB CDC UVC

compatible: "zephyr,cdc-uvc"

on-bus: usb
```

## dts/bindings/usb/lattice,usb23-auto-ep.yaml
```yaml
# Copyright (c) 2023 tinyVision.ai
# SPDX-License-Identifier: Apache-2.0

description: |
    Lattice USB23 Controller in device mode

compatible: "lattice,usb23-auto-ep"

include: [base.yaml]

properties:
  ep-num:
      type: int
      required: true
  trbs:
      type: int
      required: true
  num-trbs:
      type: int
      required: true
  events:
      type: int
      required: true
```

## dts/bindings/usb/lattice,usb23-endpoints.yaml
```yaml
# Copyright (c) 2024, tinyVision.ai Inc.
# SPDX-License-Identifier: Apache-2.0

description: |
    Lattice USB23 Controller endpoint description block

include: base.yaml

compatible: "lattice,usb23-endpoints"

child-binding:
  properties:
    reg:
      type: array
      required: true
    num-trbs:
      type: int
      required: true
    uvcmanager:
      type: phandle
```

## dts/bindings/usb/lattice,usb23.yaml
```yaml
# Copyright (c) 2024, tinyVision.ai Inc.
# SPDX-License-Identifier: Apache-2.0

description: |
    Lattice USB23 Controller in device mode

compatible: "lattice,usb23"

include: usb-ep.yaml

properties:
  reg:
    required: true
  interrupts:
    required: true
```

## dts/bindings/usb/tinyvision,usb23-manager.yaml
```yaml
# Copyright (c) 2024 tinyVision.ai Inc.
# SPDX-License-Identifier: Apache-2.0

description: |
    USB Manager to control a device endpoint of Lattice USB23

compatible: "tinyvision,usb23-manager"

include: base.yaml

properties:
  reg:
    required: true
```

## dts/bindings/usb/uvc/zephyr,uvc-control-ct.yaml
```yaml
# Copyright (c) 2024 tinyVision.ai Inc.
# SPDX-License-Identifier: Apache-2.0

description: UVC Input Terminal for controlling image sensors

compatible: "zephyr,uvc-control-ct"

include: "base.yaml"

properties:

  control-target:
    type: phandle
    description: |
      Video device that will receive the camera control requests from the host
      as set_ctrl() and get_ctrl() API calls.

  control-scanning-mode:
    type: boolean
  control-ae-mode:
    type: boolean
  control-ae-priority:
    type: boolean
  control-exposure-time-absolute:
    type: boolean
  control-exposure-time-relative:
    type: boolean
  control-focus-absolute:
    type: boolean
  control-focus-relative:
    type: boolean
  control-focus-auto:
    type: boolean
  control-focus-simple:
    type: boolean
  control-iris-absolute:
    type: boolean
  control-iris-relative:
    type: boolean
  control-zoom-absolute:
    type: boolean
  control-zoom-relative:
    type: boolean
  control-pantilt-absolute:
    type: boolean
  control-pantilt-relative:
    type: boolean
  control-roll-absolute:
    type: boolean
  control-roll-relative:
    type: boolean
  control-privacy:
    type: boolean
  control-window:
    type: boolean
  control-region-of-interest:
    type: boolean
```

## dts/bindings/usb/uvc/zephyr,uvc-control-encoding.yaml
```yaml
# Copyright (c) 2024 tinyVision.ai Inc.
# SPDX-License-Identifier: Apache-2.0

description: UVC Encoding Unit controls for the compression engine

compatible: "zephyr,uvc-control-encoding.yaml"

include: "zephyr,uvc-control.yaml"

properties:

  source-entity:
    type: phandle
    requited: true
    description: |
      Entity connected as input to the Encoder.
```

## dts/bindings/usb/uvc/zephyr,uvc-control-extension.yaml
```yaml
# Copyright (c) 2024 tinyVision.ai Inc.
# SPDX-License-Identifier: Apache-2.0

description: UVC Extension Unit for custom vendor-specific controls

compatible: "zephyr,uvc-control-extension.yaml"

include: "zephyr,uvc-control.yaml"

properties:

  source-entity:
    type: phandle-array
    requited: true
    description: |
      Entities connected as input to the Extension Unit.
      The relation between controls and the source(s) is implementation-specific.
```

## dts/bindings/usb/uvc/zephyr,uvc-control-output.yaml
```yaml
# Copyright (c) 2024 tinyVision.ai Inc.
# SPDX-License-Identifier: Apache-2.0

description: UVC Output Terminal representing the data going out of the device.

compatible: "zephyr,uvc-control-output"

include: base.yaml

properties:

  source-entity:
    type: phandle
    required: true
    description: |
      Last entity of the chain before the output of the device.
```

## dts/bindings/usb/uvc/zephyr,uvc-control-pu.yaml
```yaml
# Copyright (c) 2024 tinyVision.ai Inc.
# SPDX-License-Identifier: Apache-2.0

description: UVC Processing Unit controls for the Image Signal Processor (ISP)

compatible: "zephyr,uvc-control-pu"

include: "zephyr,uvc-control.yaml"

properties:
  control-backlight-compensation:
    type: boolean
  control-brightness:
    type: boolean
  control-contrast:
    type: boolean
  control-gain:
    type: boolean
  control-power-line-frequency:
    type: boolean
  control-hue:
    type: boolean
  control-saturation:
    type: boolean
  control-sharpness:
    type: boolean
  control-gamma:
    type: boolean
  control-white-balance-temperature:
    type: boolean
  control-white-balance-component:
    type: boolean
  control-digital-multiplier:
    type: boolean
  control-digital-multiplier-limit:
    type: boolean
  control-analog-video-standard:
    type: boolean
  control-analog-lock-status:
    type: boolean
```
