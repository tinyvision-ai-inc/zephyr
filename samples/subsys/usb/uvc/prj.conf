## sample.yaml
```
sample:
  name: USB Video sample
tests:
  sample.subsys.usb.uvc:
    depends_on:
      - usbd
      - video
    tags: usb video
    platform_allow:
      - frdm_mcxn947/mcxn947/cpu0
      - mini_stm32h743
      - rpi_pico
    harness: TBD
```

## prj.conf
```kconfig
CONFIG_LOG=y
CONFIG_POLL=y
CONFIG_SAMPLE_USBD_PID=0x0011
CONFIG_SAMPLE_USBD_PRODUCT="UVC sample"
CONFIG_UDC_BUF_POOL_SIZE=2048
CONFIG_USBD_VIDEO_CLASS=y
CONFIG_USB_DEVICE_STACK_NEXT=y
CONFIG_VIDEO=y
CONFIG_VIDEO_BUFFER_POOL_NUM_MAX=2
CONFIG_VIDEO_BUFFER_POOL_SZ_MAX=24576
```

## app.overlay
```dts
/*
 * Copyright (c) 2025 tinyVision.ai Inc.
 *
 * SPDX-License-Identifier: Apache-2.0
 */

/ {
	chosen { zephyr,console = &uart0; };
	uvc: uvc {
		compatible = "zephyr,uvc-device";
	};
};
```

## boards/frdm_mcxn947_mcxn947_cpu0.overlay
```dts
/*
 * Copyright (c) 2025 tinyVision.ai Inc
 *
 * SPDX-License-Identifier: Apache-2.0
 */

#include "../app.overlay"

/{
	chosen {
		zephyr,camera = &video_sdma;
	};
};
```

## src/main.c
```c
/*
 * Copyright (c) 2025 tinyVision.ai Inc.
 *
 * SPDX-License-Identifier: Apache-2.0
 */

#include <stdint.h>
#include <stdlib.h>

#include <sample_usbd.h>

#include <zephyr/device.h>
#include <zephyr/usb/usbd.h>
#include <zephyr/drivers/video.h>
#include <zephyr/logging/log.h>
#include <zephyr/usb/class/usbd_uvc.h>

LOG_MODULE_REGISTER(uvc_sample, LOG_LEVEL_INF);

const struct device *const uvc_dev = DEVICE_DT_GET(DT_NODELABEL(uvc));

int main(void)
{
	const struct device *video_dev;
	struct usbd_context *sample_usbd;
	struct video_buffer *vbuf;
	struct video_format fmt = {0};
	struct k_poll_signal sig;
	struct k_poll_event evt[1];
	int ret;

#if DT_HAS_CHOSEN(zephyr_camera)
	video_dev = DEVICE_DT_GET(DT_CHOSEN(zephyr_camera));
#elif defined(CONFIG_VIDEO_SW_GENERATOR)
	video_dev = device_get_binding("VIDEO_SW_GENERATOR");
#else
#error A video source is required.
#endif
	if (video_dev == NULL || !device_is_ready(video_dev)) {
		LOG_ERR("video source %s is not ready or failed to initialize",
			video_dev == NULL ? "(nil)" : video_dev->name);
		return -ENODEV;
	}

	/* Must be done before initializing USB */
	LOG_INF("uvc_set_video_dev(%p %p)", uvc_dev, video_dev);
	uvc_set_video_dev(uvc_dev, video_dev);

	sample_usbd = sample_usbd_init_device(NULL);
	if (sample_usbd == NULL) {
		return -ENODEV;
	}

	ret = usbd_enable(sample_usbd);
	if (ret != 0) {
		return ret;
	}

	LOG_INF("Waiting the host to select the video format");

	/* Get the video format once it is selected by the host */
	while (true) {
		ret = video_get_format(uvc_dev, VIDEO_EP_IN, &fmt);
		if (ret == 0) {
			break;
		}
		if (ret != -EAGAIN) {
			LOG_ERR("Failed to get the video format");
			return ret;
		}

		k_sleep(K_MSEC(10));
	}

	LOG_INF("The host selected format %ux%u '%c%c%c%c'",
		fmt.width, fmt.height, fmt.pixelformat >> 24, fmt.pixelformat >> 16,
		fmt.pixelformat >> 8, fmt.pixelformat >> 0);

	LOG_INF("Preparing %u buffers of %u bytes",
		CONFIG_VIDEO_BUFFER_POOL_NUM_MAX, fmt.pitch * fmt.height);

	for (int i = 0; i < CONFIG_VIDEO_BUFFER_POOL_NUM_MAX; i++) {
		vbuf = video_buffer_alloc(fmt.pitch * fmt.height, K_NO_WAIT);
		if (vbuf == NULL) {
			LOG_ERR("Could not allocate the video buffer");
			return -ENOMEM;
		}

		ret = video_enqueue(video_dev, VIDEO_EP_OUT, vbuf);
		if (ret != 0) {
			LOG_ERR("Could not enqueue video buffer");
			return ret;
		}
	}

	LOG_DBG("Preparing signaling for %s input/output", video_dev->name);

	k_poll_signal_init(&sig);
	k_poll_event_init(&evt[0], K_POLL_TYPE_SIGNAL, K_POLL_MODE_NOTIFY_ONLY, &sig);

	ret = video_set_signal(video_dev, VIDEO_EP_OUT, &sig);
	if (ret != 0) {
		LOG_ERR("Failed to setup the signal on %s output endpoint", video_dev->name);
		return ret;
	}

	ret = video_set_signal(uvc_dev, VIDEO_EP_IN, &sig);
	if (ret != 0) {
		LOG_ERR("Failed to setup the signal on %s input endpoint", uvc_dev->name);
		return ret;
	}

	LOG_INF("Starting the video transfer");

	while (true) {
		ret = k_poll(evt, ARRAY_SIZE(evt), K_FOREVER);
		if (ret != 0) {
			LOG_ERR("Poll exited with status %d", ret);
			return ret;
		}

		if (video_dequeue(video_dev, VIDEO_EP_OUT, &vbuf, K_NO_WAIT) == 0) {
			LOG_INF("Dequeued %p from %s, enqueueing to %s",
				vbuf, video_dev->name, uvc_dev->name);

			ret = video_enqueue(uvc_dev, VIDEO_EP_IN, vbuf);
			if (ret != 0) {
				LOG_ERR("Could not enqueue video buffer to %s", uvc_dev->name);
				return ret;
			}
		}

		if (video_dequeue(uvc_dev, VIDEO_EP_IN, &vbuf, K_NO_WAIT) == 0) {
			LOG_INF("Dequeued %p from %s, enqueueing to %s",
				vbuf, uvc_dev->name, video_dev->name);

			ret = video_enqueue(video_dev, VIDEO_EP_OUT, vbuf);
			if (ret != 0) {
				LOG_ERR("Could not enqueue video buffer to %s", video_dev->name);
				return ret;
			}
		}

		k_poll_signal_reset(&sig);
	}

	CODE_UNREACHABLE;
	return 0;
}
```
